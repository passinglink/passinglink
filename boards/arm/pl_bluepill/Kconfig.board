## boards/arm/pl_bluepill/Kconfig.defconfig
```kconfig
if BOARD_PL_BLUEPILL

config BOARD
	default "pl_bluepill" if BOARD_PL_BLUEPILL

endif # BOARD_PL_STM32
```

## boards/arm/pl_bluepill/pl_bluepill_defconfig
```kconfig
CONFIG_BOARD_PL_BLUEPILL=y
CONFIG_SOC_SERIES_STM32F1X=y
CONFIG_SOC_STM32F103X8=y

CONFIG_SYS_CLOCK_HW_CYCLES_PER_SEC=72000000

CONFIG_SERIAL=n

CONFIG_CONSOLE=n
CONFIG_UART_CONSOLE=n

CONFIG_PINMUX=y
CONFIG_GPIO=y

CONFIG_CLOCK_CONTROL=y
CONFIG_CLOCK_STM32_HSE_CLOCK=8000000
CONFIG_CLOCK_STM32_SYSCLK_SRC_PLL=y

CONFIG_CLOCK_STM32_PLL_SRC_HSE=y
CONFIG_CLOCK_STM32_PLL_XTPRE=n
CONFIG_CLOCK_STM32_PLL_MULTIPLIER=9
CONFIG_CLOCK_STM32_AHB_PRESCALER=1

CONFIG_CLOCK_STM32_APB1_PRESCALER=2
CONFIG_CLOCK_STM32_APB2_PRESCALER=1
```

## boards/arm/pl_e73/Kconfig.defconfig
```kconfig
config BOARD
	default "nrf52840_mdk"

config ADC
	default y

config I2C
	default y

if USB

config USB_NRFX
	default y

config USB_DEVICE_STACK
	default y

endif # USB

config IEEE802154_NRF5
	default y
	depends on IEEE802154

config BT_CTLR
	default BT
```

## boards/arm/pl_e73/pl_e73_defconfig
```kconfig
# SPDX-License-Identifier: Apache-2.0

CONFIG_SOC_SERIES_NRF52X=y
CONFIG_SOC_NRF52840_QIAA=y
CONFIG_BOARD_PL_E73=y

CONFIG_ARM_MPU=y
CONFIG_MPU_STACK_GUARD=y

CONFIG_GPIO=y
CONFIG_GPIO_AS_PINRESET=n
CONFIG_NFCT_PINS_AS_GPIOS=y
CONFIG_CLOCK_CONTROL_NRF_K32SRC_SYNTH=y

CONFIG_SERIAL=y
CONFIG_UART_NRFX=y
CONFIG_CONSOLE=y
CONFIG_UART_CONSOLE=y
CONFIG_LOG_BACKEND_UART=y

CONFIG_I2C=y
CONFIG_I2C_0=y
CONFIG_I2C_NRFX=y

CONFIG_PASSINGLINK_INPUT_TOUCHPAD_PANTHERA=y
```

## boards/arm/pl_robotdyn_f303/Kconfig.defconfig
```kconfig
if BOARD_PL_ROBOTDYN_F303

config BOARD
	default "pl_robotdyn_f303" if BOARD_PL_ROBOTDYN_F303

if UART_CONSOLE

config UART_2
	default y

endif # UART_CONSOLE

endif # BOARD_PL_STM32
```

## boards/arm/pl_robotdyn_f303/pl_robotdyn_f303_defconfig
```kconfig
CONFIG_BOARD_PL_ROBOTDYN_F303=y
CONFIG_SOC_SERIES_STM32F3X=y
CONFIG_SOC_STM32F303XC=y

CONFIG_SYS_CLOCK_HW_CYCLES_PER_SEC=72000000

CONFIG_FLOAT=y
CONFIG_SERIAL=y

CONFIG_CONSOLE=y
CONFIG_UART_CONSOLE=y

CONFIG_PINMUX=y
CONFIG_GPIO=y

CONFIG_CLOCK_CONTROL=y
CONFIG_CLOCK_STM32_HSE_CLOCK=8000000
CONFIG_CLOCK_STM32_SYSCLK_SRC_PLL=y

CONFIG_CLOCK_STM32_PLL_SRC_HSE=y
CONFIG_CLOCK_STM32_PLL_MULTIPLIER=9
CONFIG_CLOCK_STM32_AHB_PRESCALER=1

CONFIG_CLOCK_STM32_APB1_PRESCALER=2
CONFIG_CLOCK_STM32_APB2_PRESCALER=1

CONFIG_PINMUX_STM32_DEVICE_INITIALIZATION_PRIORITY=42
```

## boards/arm/pl_stm32/Kconfig.defconfig
```kconfig
if BOARD_PL_STM32

config BOARD
	default "pl_stm32" if BOARD_PL_STM32

endif # BOARD_PL_STM32
```

## boards/stm32f4_disco.conf
```kconfig
CONFIG_BOOTLOADER_MCUBOOT=y

CONFIG_SHELL=y
CONFIG_PASSINGLINK_INPUT_EXTERNAL=y
CONFIG_PASSINGLINK_INPUT_SHELL=y

CONFIG_ENTROPY_GENERATOR=y
CONFIG_ENTROPY_STM32_RNG=y
```

## overlay/boards/microdash/Kconfig.defconfig
```kconfig
if BOARD_MICRODASH

config BOARD
	default "microdash"

if USB

config USB_NRFX
	default y

config USB_DEVICE_STACK
	default y

endif # USB

config BT_CTLR
	default BT

endif # BOARD_MICRODASH
```

## overlay/boards/microdash/microdash_defconfig
```kconfig
# SPDX-License-Identifier: Apache-2.0

CONFIG_SOC_SERIES_NRF52X=y
CONFIG_SOC_NRF52840_QIAA=y
CONFIG_BOARD_MICRODASH=y

CONFIG_ARM_MPU=y
CONFIG_MPU_STACK_GUARD=y

CONFIG_CLOCK_CONTROL_NRF_K32SRC_SYNTH=y
CONFIG_CLOCK_CONTROL_NRF_K32SRC_50PPM=y

CONFIG_GPIO=y
CONFIG_GPIO_AS_PINRESET=n
CONFIG_NFCT_PINS_AS_GPIOS=y

CONFIG_SERIAL=n

CONFIG_CONSOLE=n
CONFIG_UART_CONSOLE=n
```

## overlay/boards/pl_dongle/Kconfig.board
```kconfig
config BOARD_PL_DONGLE
  bool "Passing Link Dongle"
  depends on SOC_NRF52840_QIAA
```

## overlay/boards/pl_dongle/Kconfig.defconfig
```kconfig
if BOARD_PL_DONGLE

config BOARD
	default "pl_dongle"

if USB

config USB_NRFX
	default y

config USB_DEVICE_STACK
	default y

endif # USB

config BT_CTLR
	default BT

endif # BOARD_PL_E73
```

## overlay/boards/pl_e73/Kconfig.defconfig
```kconfig
if BOARD_PL_E73

config BOARD
	default "pl_e73"

if USB

config USB_NRFX
	default y

config USB_DEVICE_STACK
	default y

endif # USB

config BT_CTLR
	default BT

endif # BOARD_PL_E73
```

## overlay/boards/pl_e73/pl_e73_defconfig
```kconfig
# SPDX-License-Identifier: Apache-2.0

CONFIG_SOC_SERIES_NRF52X=y
CONFIG_SOC_NRF52840_QIAA=y
CONFIG_BOARD_PL_E73=y

CONFIG_ARM_MPU=y
CONFIG_MPU_STACK_GUARD=y

CONFIG_GPIO=y
CONFIG_GPIO_AS_PINRESET=n
CONFIG_NFCT_PINS_AS_GPIOS=y
CONFIG_CLOCK_CONTROL_NRF_K32SRC_SYNTH=y

CONFIG_SERIAL=y

CONFIG_CONSOLE=y
CONFIG_UART_CONSOLE=y
```

## overlay/boards/pl_robotdyn_f303/Kconfig.board
```kconfig
config BOARD_PL_ROBOTDYN_F303
	bool "RobotDyn F303 development board"
	depends on SOC_STM32F303XC
```

## overlay/boards/pl_robotdyn_f303/Kconfig.defconfig
```kconfig
if BOARD_PL_ROBOTDYN_F303

config BOARD
	default "pl_robotdyn_f303" if BOARD_PL_ROBOTDYN_F303

endif # BOARD_PL_STM32
```

## overlay/boards/pl_stm32/pl_stm32_defconfig
```kconfig
CONFIG_BOARD_PL_STM32=y
CONFIG_SOC_SERIES_STM32F1X=y
CONFIG_SOC_STM32F103XE=y

CONFIG_SYS_CLOCK_HW_CYCLES_PER_SEC=72000000

CONFIG_SERIAL=y

CONFIG_CONSOLE=y
CONFIG_UART_CONSOLE=y

CONFIG_PINMUX=y
CONFIG_GPIO=y

CONFIG_CLOCK_CONTROL=y
CONFIG_CLOCK_STM32_HSE_CLOCK=8000000
CONFIG_CLOCK_STM32_SYSCLK_SRC_PLL=y

CONFIG_CLOCK_STM32_PLL_SRC_HSE=y
CONFIG_CLOCK_STM32_PLL_MULTIPLIER=9
CONFIG_CLOCK_STM32_AHB_PRESCALER=1

CONFIG_CLOCK_STM32_APB1_PRESCALER=2
CONFIG_CLOCK_STM32_APB2_PRESCALER=1

CONFIG_PINMUX_STM32_DEVICE_INITIALIZATION_PRIORITY=42
```
